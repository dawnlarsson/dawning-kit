## linux/src/Kconfig
```kconfig
menu "Moonwater"
    config MOONWATER_CORE
        tristate "Moonwater core"
        default y
        help
          Enable the Moonwater core: the spark binary format, /dev/spark and the compositor

    config MOONWATER_DISPLAY
        bool "Moonwater in-kernel compositor"
        depends on MOONWATER_CORE && DRM && DRM_CLIENT
        default y
        help
          Own the display from kernel space: the compositor draws the
          desktop, windows and cursor itself through the in-kernel DRM
          client API rather than handing a device node to a userspace
          display server.
endmenu # Moonwater
```

## src/Kconfig
```kconfig
menu "Moonwater"
    config MOONWATER_CORE
        tristate "Moonwater core"
        default y
        help
          Enable the Moonwater core: the spark binary format, /dev/spark and Canvas

    config MOONWATER_SHELL
        bool "Bundle the Moonwater shell in the initial filesystem"
        depends on MOONWATER_CORE=y
        default y
        help
          Build the Spark shell and install it as /shell, /init and /bin/sh.
          Disable this when another initramfs supplies its own init and command
          interpreter. Disable MOONWATER_UTILITIES as well for a kernel-only
          image with no bundled userspace payload. The repository's fs/
          directory is generated output; point CONFIG_INITRAMFS_SOURCE at a
          separate tree or archive when supplying a replacement init.

    config MOONWATER_SHELL_MONITOR
        bool "Bundle the native resource monitor"
        depends on MOONWATER_SHELL && MOONWATER_UTILITIES
        default y
        help
          Build the persistent monitor applet and install monitor.sh plus its
          historical mointor.sh spelling as thin launchers. The monitor reads
          typed shared snapshots and keeps its previous sample in memory,
          avoiding the process and temporary-file cost of a shell dashboard.

    config MOONWATER_UTILITIES
        bool "Bundle the general utility surface"
        depends on MOONWATER_CORE=y
        default y
        help
          Build and install the core, file, text and network utility surface.
          When the shell is enabled its one shared binary provides the applets;
          otherwise a utility-only Spark entrypoint is built and unknown names
          cannot fall through into an interactive shell. The utility-only
          binary retains the /shell path used by the kernel's accelerated tool
          spawning ABI, but /bin/sh and /init are not installed.

          Disabling this option removes the applet registry roots so linker
          garbage collection drops their unreferenced code. Shared helpers
          still needed by the enabled shell remain.

    config MOONWATER_UTIL_LINUX
        bool "Bundle util-linux compatible utilities"
        depends on MOONWATER_UTILITIES
        default y
        help
          Install mount, process-policy, namespace and related util-linux
          compatible applet names, including their conventional /bin and
          /sbin aliases. Disabling this removes the util-linux registry roots;
          only helpers independently needed by another enabled component
          remain in the linked image.

    config MOONWATER_CANVAS
        bool "Moonwater Canvas, the in-kernel compositor"
        depends on MOONWATER_CORE && DRM && DRM_CLIENT
        select FONT_SUPPORT
        select FONT_8x16
        default y
        help
          Own the display from kernel space: Canvas draws the desktop,
          windows and cursor itself through the in-kernel DRM client API
          rather than handing a device node to a userspace display
          server. Its source is src/canvas/. Disable this option to omit the
          compositor C and architecture-specific renderer assembly entirely;
          Moonwater core, Spark programs and the ordinary kernel consoles
          remain available.

    config MOONWATER_CANVAS_AUTOSTART
        bool "Start Canvas automatically during boot"
        depends on MOONWATER_CANVAS && MOONWATER_SHELL
        default y
        help
          Probe DRM devices and start the Canvas desktop and its terminal as
          soon as display drivers appear.

          Disable this while keeping MOONWATER_CANVAS enabled to retain the
          compositor in the image without claiming a display at boot. The
          ordinary framebuffer, virtual or serial console then owns /dev/console
          and PID 1 starts the shell directly on it. Ensure the kernel command
          line does not contain drm_client_lib.active=, which intentionally
          suppresses the framebuffer console for a Canvas-first desktop.

    config MOONWATER_CANVAS_SCALE
        int "How many device pixels one drawn pixel is"
        depends on MOONWATER_CANVAS
        default 1
        help
          A cell is eight by sixteen and a titlebar is twenty. Those are
          the right numbers on an ordinary screen and a quarter of the
          right numbers on a dense one, where everything comes out too
          small to read. This multiplies every metric the compositor
          draws for itself, so the same window covers the same area of
          glass whatever the panel is.

          Two for a Retina class display, three past about two hundred
          and sixty dots to the inch.

          It is a number here and not a measurement because a virtual
          display's reported size is fiction -- bochs answers 320 by 200
          millimetres whatever mode it is in, so dots per inch worked out
          from it swings with the resolution and says nothing.

    config MOONWATER_CANVAS_LARGEST_MODE
        bool "Drive every screen at the largest mode it lists"
        depends on MOONWATER_CANVAS
        default y
        help
          A monitor's preferred mode is a recommendation, not its
          maximum: an Odyssey G9 marks 3840x1080 preferred and will run
          5120x1440, so taking the preferred one leaves most of the panel
          dark.

          A virtual display is halved regardless, whatever this says: its
          screen belongs to a host that is still using it, and filling it
          takes the machine the emulator is running on with it. Which
          displays are virtual is decided by the driver's name, not by
          anything the display claims about itself.
endmenu # Moonwater
```
